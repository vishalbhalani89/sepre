## bbb/buildroot/sepre_bb_qt5_defconfig
```kconfig
BR2_arm=y
BR2_cortex_a8=y
BR2_GLOBAL_PATCH_DIR="board/beaglebone/patches"
# BR2_COMPILER_PARANOID_UNSAFE_PATH is not set
BR2_REPRODUCIBLE=y
BR2_TOOLCHAIN_BUILDROOT_VENDOR="sepre"
BR2_TOOLCHAIN_BUILDROOT_GLIBC=y
BR2_KERNEL_HEADERS_4_9=y
BR2_GCC_VERSION_5_X=y
BR2_TOOLCHAIN_BUILDROOT_CXX=y
BR2_PACKAGE_HOST_GDB=y
BR2_PACKAGE_HOST_GDB_PYTHON=y
BR2_TARGET_GENERIC_HOSTNAME="sepre"
BR2_TARGET_GENERIC_ISSUE="Welcome to Sepre"
BR2_TARGET_GENERIC_PASSWD_SHA512=y
BR2_INIT_SYSTEMD=y
BR2_TARGET_GENERIC_ROOT_PASSWD="legend"
# BR2_TARGET_GENERIC_GETTY is not set
BR2_SYSTEM_DHCP="eth0"
BR2_ROOTFS_USERS_TABLES="board/beaglebone/post_build/users.list"
BR2_ROOTFS_OVERLAY="board/beaglebone/sepre-overlay/"
BR2_ROOTFS_POST_IMAGE_SCRIPT="board/beaglebone/post-image.sh"
BR2_LINUX_KERNEL=y
BR2_LINUX_KERNEL_CUSTOM_GIT=y
BR2_LINUX_KERNEL_CUSTOM_REPO_URL="https://github.com/beagleboard/linux.git"
BR2_LINUX_KERNEL_CUSTOM_REPO_VERSION="a3f9666c15aa06cace895a18e6014542f8cb24ea"
BR2_LINUX_KERNEL_DEFCONFIG="bb.org"
BR2_LINUX_KERNEL_XZ=y
BR2_LINUX_KERNEL_DTS_SUPPORT=y
BR2_LINUX_KERNEL_INTREE_DTS_NAME="am335x-evm am335x-bone am335x-boneblack am335x-evmsk"
BR2_PACKAGE_LINUX_TOOLS_GPIO=y
BR2_PACKAGE_BUSYBOX_WATCHDOG=y
BR2_PACKAGE_GDB=y
BR2_PACKAGE_FONT_AWESOME=y
BR2_PACKAGE_FBV=y
BR2_PACKAGE_QT5=y
BR2_PACKAGE_QT5BASE_CONCURRENT=y
BR2_PACKAGE_QT5BASE_DEFAULT_QPA="linuxfb"
BR2_PACKAGE_QT5DECLARATIVE=y
BR2_PACKAGE_AM335X_PRU_PACKAGE=y
BR2_PACKAGE_USB_MODESWITCH=y
BR2_PACKAGE_LIBDRM=y
BR2_PACKAGE_LIBDRM_OMAP=y
BR2_PACKAGE_DTC=y
BR2_PACKAGE_OPENSSH=y
BR2_PACKAGE_RPM=y
BR2_PACKAGE_SUDO=y
BR2_PACKAGE_ACL=y
BR2_TARGET_ROOTFS_INITRAMFS=y
BR2_TARGET_UBOOT=y
BR2_TARGET_UBOOT_BUILD_SYSTEM_KCONFIG=y
BR2_TARGET_UBOOT_CUSTOM_VERSION=y
BR2_TARGET_UBOOT_CUSTOM_VERSION_VALUE="2016.09.01"
BR2_TARGET_UBOOT_BOARD_DEFCONFIG="am335x_evm"
BR2_TARGET_UBOOT_NEEDS_DTC=y
# BR2_TARGET_UBOOT_FORMAT_BIN is not set
BR2_TARGET_UBOOT_FORMAT_IMG=y
BR2_TARGET_UBOOT_FORMAT_CUSTOM=y
BR2_TARGET_UBOOT_FORMAT_CUSTOM_NAME="spl/u-boot-spl.bin"
BR2_TARGET_UBOOT_SPL=y
BR2_TARGET_UBOOT_SPL_NAME="MLO"
```

## buildroot/sepre_defconfig
```kconfig
BR2_arm=y
BR2_cortex_a53=y
BR2_ARM_FPU_NEON_VFPV4=y
BR2_TOOLCHAIN_BUILDROOT_VENDOR="sepre"
BR2_TOOLCHAIN_BUILDROOT_GLIBC=y
BR2_PACKAGE_HOST_LINUX_HEADERS_CUSTOM_4_9=y
BR2_TOOLCHAIN_BUILDROOT_CXX=y
BR2_PACKAGE_HOST_GDB=y
BR2_PACKAGE_HOST_GDB_PYTHON=y
BR2_TARGET_GENERIC_HOSTNAME="sepre"
BR2_TARGET_GENERIC_ISSUE="Welcome to Sepre"
BR2_TARGET_GENERIC_PASSWD_SHA512=y
BR2_INIT_SYSTEMD=y
BR2_TARGET_GENERIC_ROOT_PASSWD="legend"
BR2_SYSTEM_DHCP="eth0"
BR2_ROOTFS_POST_BUILD_SCRIPT="board/raspberrypi3/post-build.sh"
BR2_ROOTFS_POST_IMAGE_SCRIPT="board/raspberrypi3/post-image.sh"
BR2_ROOTFS_POST_SCRIPT_ARGS="--add-pi3-miniuart-bt-overlay"
BR2_LINUX_KERNEL=y
BR2_LINUX_KERNEL_CUSTOM_GIT=y
BR2_LINUX_KERNEL_CUSTOM_REPO_URL="https://github.com/raspberrypi/linux.git"
BR2_LINUX_KERNEL_CUSTOM_REPO_VERSION="5e4ee836560d4c0371e109bf469e1ad808ae7a44"
BR2_LINUX_KERNEL_DEFCONFIG="bcm2709"
BR2_LINUX_KERNEL_DTS_SUPPORT=y
BR2_LINUX_KERNEL_INTREE_DTS_NAME="bcm2710-rpi-3-b bcm2710-rpi-cm3"
BR2_PACKAGE_BUSYBOX_WATCHDOG=y
BR2_PACKAGE_GDB=y
BR2_PACKAGE_LOHIT=y
BR2_PACKAGE_LOHIT_ASSAMESE=y
BR2_PACKAGE_LOHIT_BENGALI=y
BR2_PACKAGE_LOHIT_GUJARATI=y
BR2_PACKAGE_LOHIT_HINDI=y
BR2_PACKAGE_LOHIT_KANNADA=y
BR2_PACKAGE_LOHIT_KASHMIRI=y
BR2_PACKAGE_LOHIT_KONKANI=y
BR2_PACKAGE_LOHIT_MAITHILI=y
BR2_PACKAGE_LOHIT_MALAYALAM=y
BR2_PACKAGE_LOHIT_MARATHI=y
BR2_PACKAGE_LOHIT_NEPALI=y
BR2_PACKAGE_LOHIT_ORIYA=y
BR2_PACKAGE_LOHIT_PUNJABI=y
BR2_PACKAGE_LOHIT_SINDHI=y
BR2_PACKAGE_LOHIT_TAMIL=y
BR2_PACKAGE_LOHIT_TELUGU=y
BR2_PACKAGE_QT5=y
BR2_PACKAGE_QT5_VERSION_5_6=y
BR2_PACKAGE_QT5BASE_GUI=y
BR2_PACKAGE_QT5BASE_WIDGETS=y
BR2_PACKAGE_QT5BASE_DEFAULT_QPA="linuxfb"
BR2_PACKAGE_RPI_FIRMWARE=y
BR2_PACKAGE_OPENSSH=y
BR2_PACKAGE_HOST_DOSFSTOOLS=y
BR2_PACKAGE_HOST_GENIMAGE=y
BR2_PACKAGE_HOST_MKE2IMG=y
BR2_PACKAGE_HOST_MTOOLS=y
```

## lohit/Config.in
```kconfig
config BR2_PACKAGE_LOHIT
	bool "lohit fonts"
	help
	  The lohit fonts are a font family designed to cover Indic 
	  scripts and released by Red Hat.
	  From September 2011, they were licensed under the OFL.

	  https://pagure.io/lohit

if BR2_PACKAGE_LOHIT

config BR2_PACKAGE_LOHIT_ASSAMESE
	bool "assamese fonts"
	default n

config BR2_PACKAGE_LOHIT_BENGALI
	bool "bengali fonts"
	default n

config BR2_PACKAGE_LOHIT_GUJARATI
	bool "gujarati fonts"
	default n

config BR2_PACKAGE_LOHIT_HINDI
	bool "hindi fonts"
	default n

config BR2_PACKAGE_LOHIT_KANNADA
	bool "kannada fonts"
	default n

config BR2_PACKAGE_LOHIT_KASHMIRI
	bool "kashmiri of devanagari fonts"
	default n

config BR2_PACKAGE_LOHIT_KONKANI
	bool "konkani fonts"
	default n

config BR2_PACKAGE_LOHIT_MAITHILI
	bool "maithili fonts"
	default n

config BR2_PACKAGE_LOHIT_MALAYALAM
	bool "malayalam fonts"
	default n

config BR2_PACKAGE_LOHIT_MARATHI
	bool "marathi fonts"
	default n

config BR2_PACKAGE_LOHIT_NEPALI
	bool "nepali fonts"
	default n

config BR2_PACKAGE_LOHIT_ORIYA
	bool "oriya fonts"
	default n

config BR2_PACKAGE_LOHIT_PUNJABI
	bool "punjabi fonts"
	default n

config BR2_PACKAGE_LOHIT_SINDHI
	bool "sindhi of devanagari fonts"
	default n

config BR2_PACKAGE_LOHIT_TAMIL
	bool "tamil fonts"
	default n

config BR2_PACKAGE_LOHIT_TELUGU
	bool "telugu fonts"
	default n

endif
```
